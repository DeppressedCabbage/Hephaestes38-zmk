## boards/shields/Hephaestes38/Kconfig.defconfig
```kconfig
if SHIELD_HEPHAESTES38

# Name must be less than 16 characters long!
config ZMK_KEYBOARD_NAME
    default "Hephaestes38"

endif
```

## boards/shields/Hephaestes38/Kconfig.shield
```kconfig
# No whitespace after the comma or in your keyboard name!
config SHIELD_HEPHAESTES38
    def_bool $(shields_list_contains,Hephaestes38)

CONFIG_ZMK_EXT_POWER
```

## config/west.yml
```yaml
manifest:
  remotes:
    - name: zmkfirmware
      url-base: https://github.com/zmkfirmware
    # Additional modules containing boards/shields/custom code can be listed here as well
    # See https://docs.zephyrproject.org/3.2.0/develop/west/manifest.html#projects
    - name: m165437 #new entry
      url-base: https://github.com/M165437 #new entry
  projects:
    - name: zmk
      remote: zmkfirmware
      revision: main
      import: app/west.yml
    - name: nice-view-gem #new entry
      remote: m165437 #new entry
      revision: main #new entry
  self:
    path: config
```
